## boards/arm/nrf52840dk_nrf52840_v1/Kconfig.defconfig
```kconfig
# nRF52840 DK NRF52840 board configuration

# Copyright (c) 2016 Nordic Semiconductor ASA
# SPDX-License-Identifier: Apache-2.0

if BOARD_NRF52840DK_NRF52840_V1

config BOARD
	default "nrf52840dk_nrf52840_v1"

config BT_CTLR
	default BT

endif # BOARD_NRF52840DK_NRF52840
```
